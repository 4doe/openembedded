## conf/machine/tmtwin.conf
```bitbake
#@TYPE: Machine
#@NAME: TM twin 
#@DESCRIPTION: Machine configuration for the Vu+ Duo

UPDATE_DIR = "tmtwin"

include tmxxe.inc

MACHINE_FEATURES += "kernel26 alsa usbhost wifi nl80211"

# openpli specific features:
MACHINE_FEATURES += "32bpp hdtv switchoff lpcm textlcd dvbapi5"

CHIPSET = "bcm7335"

MACHINE_KERNEL_PR = "r4"
```
